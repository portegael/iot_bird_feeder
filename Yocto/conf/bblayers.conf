## Yocto/conf/bblayers.conf
```bitbake
# POKY_BBLAYERS_CONF_VERSION is increased each time build/conf/bblayers.conf
# changes incompatibly
  
POKY_BBLAYERS_CONF_VERSION = "2"

BBPATH = "${TOPDIR}"
BBFILES ?= ""

BBLAYERS ?= " \
  /home/gael/Development/Yocto/poky/meta \
  /home/gael/Development/Yocto/poky/meta-poky \
  /home/gael/Development/Yocto/poky/meta-yocto-bsp \
  /home/gael/Development/Yocto/poky/meta-qt5 \
  /home/gael/Development/Yocto/poky/meta-raspberrypi \
  /home/gael/Development/Yocto/poky/meta-openembedded/meta-oe \
  /home/gael/Development/Yocto/poky/meta-openembedded/meta-multimedia \
  /home/gael/Development/Yocto/poky/meta-openembedded/meta-networking \
  /home/gael/Development/Yocto/poky/meta-openembedded/meta-python \
  /home/gael/Development/Yocto/poky/meta-aixpi \
  "
```

## Yocto/meta-aixpi/conf/layer.conf
```bitbake
# We have a conf and classes directory, add to BBPATH
BBPATH .= ":${LAYERDIR}"

# We have recipes-* directories, add to BBFILES
BBFILES += "${LAYERDIR}/recipes-*/*/*.bb ${LAYERDIR}/recipes-*/*/*.bbappend"

BBFILE_COLLECTIONS += "aixpi"
BBFILE_PATTERN_aixpi = "^${LAYERDIR}/"
BBFILE_PRIORITY_aixpi = "1"

# This should only be incremented on significant changes that will
# cause compatibility issues with other layers
LAYERVERSION_aixpi = "1"

LAYERDEPENDS_aixpi = "core"
```
